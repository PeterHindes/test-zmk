## boards/shields/just_pins/Kconfig.defconfig
```kconfig
# Copyright (c) 2022 The ZMK Contributors
# SPDX-License-Identifier: MIT

if SHIELD_JUST_PINS

config ZMK_KEYBOARD_NAME
    default "Just Pins"

endif
```

## boards/shields/just_pins/Kconfig.shield
```kconfig
# Copyright (c) 2022 The ZMK Contributors
# SPDX-License-Identifier: MIT

config SHIELD_JUST_PINS
    def_bool $(shields_list_contains,just_pins)
```
